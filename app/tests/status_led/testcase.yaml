## app/tests/status_led/testcase.yaml
```yaml
tests:
  smarthome.status_led.initial_state:
    tags: smarthome gpio
    harness: ztest
    integration_platforms:
      - native_sim
```

## app/tests/temperature/testcase.yaml
```yaml
tests:
  smarthome.temperature.formatting:
    tags: smarthome sensor
    harness: ztest
    integration_platforms:
      - native_sim
```
